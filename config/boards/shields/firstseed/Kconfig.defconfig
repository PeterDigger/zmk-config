## config/boards/shields/firstseed/Kconfig.defconfig
```kconfig
if SHIELD_FIRSTSEED

config ZMK_KEYBOARD_NAME
    default "firstseed"

config ZMK_USB
    default y

endif
```

## config/boards/shields/firstseed/boards/seeeduino_xiao.conf
```kconfig
CONFIG_EC11=y
CONFIG_EC11_TRIGGER_GLOBAL_THREAD=y

CONFIG_CONSOLE=n
CONFIG_UART_CONSOLE=n
CONFIG_UART_INTERRUPT_DRIVEN=n
CONFIG_SERIAL=n
```
